## conf/layer.conf
```bitbake
BBPATH := "${BBPATH}:${LAYERDIR}" 

BBFILES := "${BBFILES} ${LAYERDIR}/recipes-*/*/*.bb \ 
           ${LAYERDIR}/recipes-*/*/*.bbappend \
	   ${LAYERDIR}/images/*.bb*"


BBFILE_COLLECTIONS += "gyroidos-intel"
BBFILE_PATTERN_gyroidos-intel := "^${LAYERDIR}/"
BBFILE_PRIORITY_gyroidos-intel := "7"

LAYERDEPENDS_gyroidos-intel = "gyroidos-layer"

LAYERSERIES_COMPAT_gyroidos-intel += "kirkstone"
```
